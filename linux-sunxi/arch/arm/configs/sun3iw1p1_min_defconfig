## linux-sunxi/arch/arm/mach-sunxi/Kconfig
```kconfig
if ARCH_SUNXI

choice
	prompt "Select the architecture of SoC"
	default ARCH_SUN8I
	help
	  Select the architecture for SoC
	  sunxi
	  `-- sun8i ----- Cortex-A7 based Family SoCs

config ARCH_SUN8I
	bool "Allwinner A7 smp SoCs"
	select ARM_GIC
	select CPU_V7
	select HAVE_SMP if !ARCH_SUN8IW8
	select SUNXI_TIMER
	select COMMON_CLK
	select CLKDEV_LOOKUP
	select NEED_MACH_IO_H
	select MIGHT_HAVE_CACHE_L2X0
	select PINCTRL
	select PINCTRL_SUNXI
	select ARCH_REQUIRE_GPIOLIB
	select CLKSRC_MMIO
	select CLKSRC_OF
	select GENERIC_CLOCKEVENTS
	select GENERIC_IRQ_CHIP
	select SPARSE_IRQ
	select SUN4I_TIMER
	select GENERIC_ALLOCATOR
	help
	  Allwinner A7 smp SoCs(sun8i)

config ARCH_SUN50I
	bool "Allwinner A53 smp SoCs"
	select ARM_GIC
	select CPU_V7
	select HAVE_SMP if !ARCH_SUN8IW8
	select SUNXI_TIMER
	select COMMON_CLK
	select CLKDEV_LOOKUP
	select NEED_MACH_IO_H
	select MIGHT_HAVE_CACHE_L2X0
	select PINCTRL
	select PINCTRL_SUNXI
	select ARCH_REQUIRE_GPIOLIB
	select CLKSRC_MMIO
	select CLKSRC_OF
	select GENERIC_CLOCKEVENTS
	select GENERIC_IRQ_CHIP
	select SPARSE_IRQ
	select SUN4I_TIMER
	select GENERIC_ALLOCATOR
	help
	  Allwinner A53 smp SoCs(sun50i)

config ARCH_SUN3I
	bool "Allwinner arm926ejs socs(sun3i)"
	select CPU_ARM926T
	select SUNXI_TIMER
	select COMMON_CLK
	select CLKDEV_LOOKUP
	select NEED_MACH_IO_H
	select MULTI_IRQ_HANDLER
	select PINCTRL
	select PINCTRL_SUNXI
	select ARCH_REQUIRE_GPIOLIB
	select CLKSRC_MMIO
	select CLKSRC_OF
	select OF_RESERVED_MEM
	select GENERIC_CLOCKEVENTS
	select GENERIC_IRQ_CHIP
	select SUN4I_TIMER
	help
	  Allwinner arm926ejs socs

endchoice

# Select the wafer with sun8i

if ARCH_SUN8I
choice
	prompt "Select the wafer with arch sun8i"
	default ARCH_SUN8IW8
	help
	  Select the wafer with arch sun8i

config ARCH_SUN8IW5
	bool "Allwinner sun8iw5 SoCs"
	select HAVE_UNSTABLE_SCHED_CLOCK
	help
	Allwinner sun8iw5 SoCs

config ARCH_SUN8IW8
	bool "Allwinner sun8iw8 SoCs"
	select HAVE_UNSTABLE_SCHED_CLOCK
	help
	Allwinner sun8iw8 SoCs

config ARCH_SUN8IW10
        bool "Allwinner sun8iw10 SoCs"
	select HAVE_UNSTABLE_SCHED_CLOCK
        help
          Allwinner sun8iw10 SoCs

config ARCH_SUN8IW11
        bool "Allwinner sun8iw11 SoCs"
	select HAVE_UNSTABLE_SCHED_CLOCK
        help
          Allwinner sun8iw11 SoCs

config ARCH_SUN8IW17
        bool "Allwinner sun8iw17 SoCs"
        help
          Allwinner sun8iw17 SoCs
endchoice

config SUN8I_CCI
       bool "Cache Coherent Interconnect support"
       depends on ARCH_SUN8IW17
       default n
       help
         Enable Cache Coherent Interconnect support
endif

# Select the SoC with specific arch and wafer

if ARCH_SUN8IW5
choice
	prompt "Select the SoC with wafer sun8iw5"
	default ARCH_SUN8IW5P1
	help
	Select the SoC with wafer sun8iw5

config ARCH_SUN8IW5P1
	bool "Allwinner sun8iw5p1 SoC"
	help
	Allwinner sun8iw5p1 SoC
endchoice
endif

if ARCH_SUN8IW8
choice
	prompt "Select the SoC with wafer sun8iw8"
	default ARCH_SUN8IW8P1
	help
	Select the SoC with wafer sun8iw8

config ARCH_SUN8IW8P1
	bool "Allwinner sun8iw8p1 SoC"
	help
	Allwinner sun8iw8p1 SoC
endchoice
endif

if ARCH_SUN8IW10
choice
       prompt "Select the SoC with wafer sun8iw10"
       default ARCH_SUN8IW10P1
       help
        Select the SoC with wafer sun8iw10

config ARCH_SUN8IW10P1
       bool "Allwinner sun8iw10p1 SoC"
       help
         Allwinner sun8iw10p1 SoC
endchoice
endif

if ARCH_SUN8IW11
choice
	prompt "Select the SoC with wafer sun8iw11"
	default ARCH_SUN8IW11P1
	help
	 Select the SoC with wafer sun8iw11

config ARCH_SUN8IW11P1
	bool "Allwinner sun8iw11p1 SoC"
	help
	  Allwinner sun8iw11p1 SoC
endchoice
endif

if ARCH_SUN8IW17
choice
	prompt "Select the SoC with wafer sun8iw17"
	default ARCH_SUN8IW17P1
	help
	 Select the SoC with wafer sun8iw17

config ARCH_SUN8IW17P1
	bool "Allwinner sun8iw17p1 SoC"
	help
	  Allwinner sun8iw17p1 SoC
endchoice
endif

# Select the board between FPGA and EVB

choice
	prompt "Allwinner development Board"
	depends on ARCH_SUNXI
	default FPGA_V4_PLATFORM

config FPGA_V4_PLATFORM
       bool "FPGAv4 board"
       help
         Support for Allwinner's FPGAv4 board

config FPGA_V7_PLATFORM
       bool "FPGAv7 board"
       help
         Support for Allwinner's FPGAv4 board

config EVB_PLATFORM
       bool "EVB board"
       help
         Support for Allwinner's EVB board
endchoice

# Select the wafer with sun50i

if ARCH_SUN50I
choice
	prompt "Select the wafer with arch sun50i"
	default ARCH_SUN50IW1
	help
	  Select the wafer with arch sun50i

config ARCH_SUN50IW1
        bool "Allwinner sun50iw1 SoCs"
	select HAVE_UNSTABLE_SCHED_CLOCK
        help
          Allwinner sun50iw1 SoCs

config ARCH_SUN50IW2
        bool "Allwinner sun50iw2 SoCs"
	select HAVE_UNSTABLE_SCHED_CLOCK
        help
          Allwinner sun50iw2 SoCs
endchoice
endif

# Select the SoC with specific arch and wafer

if ARCH_SUN50IW1
choice
       prompt "Select the SoC with wafer sun50iw1"
       default ARCH_SUN50IW1P1
       help
        Select the SoC with wafer sun50iw1

config ARCH_SUN50IW1P1
       bool "Allwinner sun50iw1p1 SoC"
       help
         Allwinner sun50iw1p1 SoC
endchoice
endif

if ARCH_SUN50IW2
choice
	prompt "Select the SoC with wafer sun50iw2"
	default ARCH_SUN50IW2P1
	help
	 Select the SoC with wafer sun50iw2

config ARCH_SUN50IW2P1
	bool "Allwinner sun50iw2p1 SoC"
	help
	  Allwinner sun50iw2p1 SoC
endchoice
endif

if ARCH_SUN3I
choice
	prompt "Select the wafer with arch sun3i"
	default ARCH_SUN3IW1
	help
	 Select the wafer with arch sun3i

config ARCH_SUN3IW1
	bool "Allwinner sun3iw1 SOC"
	help
	  Allwinner sun3iw1 SOC
endchoice
endif

if ARCH_SUN3IW1
choice
	prompt "Select the Soc with wafer sun3iw1"
	default ARCH_SUN3IW1P1
	help
	 Select the SoC with wafer sun3iw1

config ARCH_SUN3IW1P1
	bool "Allwinner sun3iw1p1 SoC"
	help
	  Allwinner sun3iw1p1 SoC
endchoice
endif

if ARCH_SUN3IW1P1
choice
	prompt "Select the target board with sun3iw1p1"
	default ARCH_SUN3IW1P1_C600
	help
	  Select the target board with sun3iw1p1

config ARCH_SUN3IW1P1_C600
	bool "Allwinner sun3iw1p1 C600"
	help
	  Allwinner sun3iw1p1 C600 Soc

config ARCH_SUN3IW1P1_R6
	bool "Allwinner sun3iw1p1 R6"
	help
	  Allwinner sun3iw1p1 R6 Soc
endchoice
endif

config SUNXI_TRUSTZONE
       bool "SUNXI trustzone security"
       default n
    help
        Support for SUNXI trustzone security

config HOMLET_PLATFORM
       bool "Homlet platform Features"
       default n
       help
         Enable special features for box then select Yes,
         For example, fsync & sync immediatetly to nand disk.

config SUNXI_BOOTUP_EXTEND
        bool "Homlet platform bootup extend"
        depends on HOMLET_PLATFORM
        default n
    help
        Support system bootup triggered by ir, when system is poweroff.

config SUNXI_SOC_NAME
	string "The name of SUNXI SoC"
	default ""
	help
	  Used for /proc/cpuinfo and /sysfs/.../sysinfo.

endif
```

## linux-sunxi/drivers/arisc/Kconfig
```kconfig
#
# sunxi arisc driver configuration.
#
config SUNXI_ARISC
	tristate "sunxi arisc driver"
	depends on ARCH_SUNXI && HWSPINLOCK_SUNXI
	help
	  Arisc driver support sunxi family SOCs.
	  Previously known as "ar100" or "cpus".
	  Set y here to support the sunxi arisc driver.
	  If unsure, set N.

config MCPM_WITH_ARISC_DVFS_SUPPORT
	tristate "mcpm with arisc dvfs support"
	depends on MCPM && CPU_FREQ
	depends on EVB_PLATFORM && SUNXI_ARISC
	help
	  Arisc driver support dvfs when mcpm init.
	  Set y here to support mcpm with arisc dvfs.
	  If unsure, set N.

config SUNXI_ARISC_COM_DIRECTLY
       bool "sunxi arsic communate directly"
       depends on SUNXI_ARISC && !ARCH_SUN50I
       help
         Arisc driver communate with cpus directly, because
	 there is not atf.
```

## linux-sunxi/drivers/char/sunxi-sysinfo/Kconfig
```kconfig
#
# sunxi system information driver.
#

config SUNXI_SYS_INFO
	tristate "sunxi system info driver"
	default y
	help
	  This driver is used for query system informations.
	  If you don't know whether need it, please select y.

config SUNXI_QA_TEST
	bool "sunxi QA test"
	depends on SUNXI_SYS_INFO
	help
	  support sunxi QA test.

config SUNXI_RD_DEBUG
	bool "sunxi RD debug"
	depends on SUNXI_SYS_INFO
	help
	  It is used for sunxi rd debug,
	  sid can be readed even the write protect bit not be burned.

config SUNXI_SMC
	bool "sunxi smc interfaces"
	default n
	help
	  This driver support smc call interfaces depended on
	  monitor/aft/SecureOs. If you don't know whether need
	  it, please select y.
```

## linux-sunxi/drivers/crypto/sunxi/Kconfig
```kconfig
config CRYPTO_SUNXI
	tristate "Sunxi CryptoEngine controller"
	depends on ARCH_SUNXI
	help
	  To compile this driver as a module, choose M here: the module
	  will be called caam.

config CRYPTO_SUNXI_SS_KL
	bool "Sunxi ss key ladder support"
	depends on CRYPTO_SUNXI && AW_TSC && TEE_SUPPORT
	help
	  Sunxi CryptoEngine key ladder support.
```

## linux-sunxi/drivers/input/touchscreen/gt927/Kconfig
```kconfig
#
#  Touchscreen driver configuration
#
config  TOUCHSCREEN_GT927_TS
       tristate  "gt927 touchscreen driver"
       depends on INPUT && I2C
       default m
       help
         gt927 touchscreen driver
```

## linux-sunxi/drivers/input/touchscreen/icn85xx/Kconfig
```kconfig
#
#  Touchscreen driver configuration
#

config  TOUCHSCREEN_ICN85XX_TS
       tristate  "icn85xx touchscreen driver"      
       depends on INPUT && I2C
       default m
       help
         icn85xx touchscreen driver    
```

## linux-sunxi/drivers/media/platform/sunxi-eve/Kconfig
```kconfig
#
# embedded vision engine device configuration
#
config SUNXI_EVE
	tristate "EVE driver"
	default n
	---help---
	This is the driver for allwinner platform embedded vision engine(EVE) module.
	To compile this driver as a module, choose M here: the
	module will be called sunxi_eve.
```

## linux-sunxi/drivers/net/wireless/xradio/Kconfig
```kconfig
menuconfig XR_WLAN
	tristate "XRadio WLAN support"
	default m
	select CFG80211
	select AVERAGE
	select CRYPTO
	select CRYPTO_ARC4
	---help---
	  To compile this code as a module, choose M here.

if XR_WLAN

source "drivers/net/wireless/xradio/umac/Kconfig"
source "drivers/net/wireless/xradio/wlan/Kconfig"

endif # XR_WLAN
```

## linux-sunxi/drivers/pci/host/Kconfig
```kconfig
menu "PCI host controller drivers"
	depends on PCI

config PCIE_SUNXI_PLAT
	bool "Platform bus based Allwiner PCIe Controller"
	depends on ARCH_SUN50IW6
	select PCIE_SUNXI
	---help---
	 This selects the Allwiner PCIe controller support. Select this if
	 you have a PCIe controller on Platform bus.

	 If you have a controller with this interface, say Y or M here.

	 If unsure, say N.

config PCIE_SUNXI_EXTERNAL_CLOCK
	bool "use PCIe enternal clock"
	depends on PCIE_SUNXI_PLAT
        default n
	help
	   If using an external clock, say y.

config PCIE_SUNXI
	bool

config PCI_SUNXI
	bool "Allwinner PCIe controller"
	depends on ARCH_SUN50IW6
	select PCIEPORTBUS
	select PCIE_SUNXI
endmenu
```

## linux-sunxi/drivers/video/sunxi/Kconfig
```kconfig
#
# Video configuration for sunxi platform
#

menu "Video support for sunxi"
	depends on FB

config FB_CONSOLE_SUNXI
  bool "Framebuffer Console Support(sunxi)"
  select FB_CFB_FILLRECT
  select FB_CFB_COPYAREA
  select FB_CFB_IMAGEBLIT
  default n
  ---help---

config DISP2_SUNXI
  tristate "DISP Driver Support(sunxi-disp2)"
  depends on (ARCH_SUNXI) && (!ARCH_SUN8IW5)
  select SYNC
  select SW_SYNC
  select SW_SYNC_USER
  default n
  ---help---

config HDMI_DISP2_SUNXI
	tristate "HDMI Driver Support(sunxi-disp2)"
	depends on (DISP2_SUNXI)
	default n
	---help---

config HDMI2_DISP2_SUNXI
  tristate "HDMI2.0 Driver Support(sunxi-disp2)"
  depends on (DISP2_SUNXI)
  default n
  ---help---
  Say Y here if you want to have support for HDMI2.0 controller
  on the sunxi based boards. The HDMI2.0 controller include edid,
  hdcp1.4,hdcp2.2,cec feature and is compatible with hdmi1.4,support
  HDR,4k@60Hz. If unsure, say N.

config TV_DISP2_SUNXI
  tristate "TV Driver Support(sunxi-disp2)"
  depends on (DISP2_SUNXI)
  default n
  ---help---

config DISP2_TV_GM7121
  tristate "GM7121 TV module Support(sunxi-disp2)"
  depends on (DISP2_SUNXI && TV_DISP2_SUNXI)
  default n
  ---help---

config EDP_DISP2_SUNXI
	tristate "EDP Driver Support(sunxi-disp2)"
	depends on (DISP2_SUNXI)
	default n
	---help---
	  EDP driver for sunxi. Embedded Display Port is
	  a high speed display interface for embedded device.

config DISP2_TV_AC200
  tristate "AC200 TV module Support(sunxi-disp2)"
  depends on (DISP2_SUNXI && MFD_ACX00)
	default n
	---help---

config EINK_PANEL_USED
  bool "Eink panel used"
  depends on (DISP2_SUNXI && ARCH_SUN8IW10)
	default n
	---help---

config DISP2_SUNXI_BOOT_COLORBAR
  bool "boot colorbar for disp driver(sunxi-disp2)"
  depends on DISP2_SUNXI
  default n
  ---help---

config DISP2_SUNXI_DEBUG
  bool "debugfs for disp driver(sunxi-disp2)"
  depends on DISP2_SUNXI
  default n
  ---help---

config FB_SUNXI
	tristate "DISP Driver Support(sunxi)"
	depends on (ARCH_SUN9IW1P1 || ARCH_SUN8IW5P1 || ARCH_SUN3IW1P1)
	default m
	---help---
	  Frame buffer driver for sunxi based boards.If you want
	  to have support, say Y here.

	  The frame buffer device provides an abstraction for the graphics
	  hardware. It represents the frame buffer of some video hardware and
	  allows application software to access the graphics hardware through
	  a well-defined interface, so the software doesn't need to know
	  anything about the low-level (hardware register) stuff.

config TV_GM7121
	tristate "GM7121 driver Support(sunxi)"
	depends on FB_SUNXI
	default m
	---help---
	 Say Y here, if you want to have support for sunxi based
	 boards with an TV module(GM7121) connected to the LCD
	 interface. GM7121 can support bothe NTSC and PAL mode.
	 If unsure, say N.

config LCD_SUNXI
	tristate "LCD Driver Support(sunxi)"
	depends on FB_SUNXI
	default m
	---help---
	 Say Y here if you want to have support for LCD controller
	 on the sunxi based boards. The LCD controller can support
	 RGB/LVDS/CPU/DSI/EDP interface depend on specified Soc.
	 If unsure, say N.

config HDMI_SUNXI
	tristate "HDMI Driver Support(sunxi)"
	depends on (ARCH_SUN9IW1P1 && FB_SUNXI)
	default m
	---help---
	 Say Y here if you want to have support for HDMI controller
	 on the sunxi based boards. The HDMI controller can support
	 480P@60HZ/576P@50HZ/720P@50HZ/720P@60HZ/1080P@50HZ/1080P@60HZ
	 mode. If unsure, say N.

endmenu
```

## linux-sunxi/kernel/Kconfig.dump
```kconfig
config SUNXI_DUMP
	bool "help to dump all dram area for crash tool"
	depends on ARCH_SUN50I
	default n
```

## linux-sunxi/sound/soc/sunxi/audiocodec/Kconfig
```kconfig
if SND_SUNXI_SOC

config SND_SUNXI_SOC_AUDIOCODEC
	tristate "Audiocodec for the SUNXI chips"
	depends on  ARCH_SUN8IW5
	select SND_SOC_DMAENGINE_PCM
	default n
	help
		Say Y or M if you want to add support for audiocodec

config SND_SUNXI_SOC_PUBLUC_MACHINE
	tristate "Audiocodec Machine for codec chips"
	depends on  ARCH_SUN8IW5
	default n
	help
		Say Y or M if you want to add audiocodec machine support

config SND_SUN8IW5_SNDCODEC
	tristate "Audiocodec for the SUN8IW5 chips"
	depends on ARCH_SUN8IW5
	default n
	help
		Say Y or M if you want to add sun8iwX audiocodec support

config SND_SUNXI_SWITCH
	tristate "headset for the SUN8IWx chips"
	depends on ARCH_SUN8IW5
	default n
	help
		Say Y or M if you want to add sun8iwX headset support

endif
```

## linux-sunxi/sound/soc/sunxi/i2s0/Kconfig
```kconfig
if SND_SUNXI_SOC

config SND_SUNXI_SOC_I2S0_INTERFACE
	tristate "SoC i2s0 interface for SUNXI chips"
	depends on ARCH_SUN8IW5
	select SND_SOC_DMAENGINE_PCM
	default n
	help
		Say Y or M if you want to add support for codecs attached to
		the SUNXI AC97, I2S or PCM interface. You will also need
		to select the audio interfaces to support below.

endif
```
